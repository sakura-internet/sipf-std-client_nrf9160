## boards/arm/m5stack_nrf9160/Kconfig.board
```kconfig
# nRF9160 M5Stack NRF9160 board configuration

# Copyright (c) 2018-2020 Nordic Semiconductor ASA
# SPDX-License-Identifier: Apache-2.0

if SOC_NRF9160_SICA

config BOARD_M5STACK_NRF9160
	bool "nRF9160 M5Stack"

config BOARD_M5STACK_NRF9160NS
	bool "nRF9160 M5Stack non-secure"

endif # SOC_NRF9160_SICA
```

## boards/arm/scm-ltem1nrf_nrf9160/Kconfig.board
```kconfig
# SCM-LTEM1NRF NRF9160 board configuration

# Copyright (c) 2018-2020 Nordic Semiconductor ASA
# SPDX-License-Identifier: Apache-2.0

if SOC_NRF9160_SICA

config BOARD_SCM_LTEM1NRF_NRF9160
	bool "SCM-LTEM1NRF NRF9160"

config BOARD_SCM_LTEM1NRF_NRF9160_NS
	bool "SCM-LTEM1NRF NRF9160 non-secure"

endif # SOC_NRF9160_SICA
```

## boards/arm/scm-ltem1nrf_nrf9160/scm-ltem1nrf_nrf9160_ns_defconfig
```kconfig
# SPDX-License-Identifier: Apache-2.0

CONFIG_SOC_SERIES_NRF91X=y
CONFIG_SOC_NRF9160_SICA=y
CONFIG_BOARD_SCM_LTEM1NRF_NRF9160_NS=y

# Enable MPU
CONFIG_ARM_MPU=y

# Enable hardware stack protection
CONFIG_HW_STACK_PROTECTION=y

# Enable TrustZone-M
CONFIG_ARM_TRUSTZONE_M=y

# This Board implies building Non-Secure firmware
CONFIG_TRUSTED_EXECUTION_NONSECURE=y

# enable GPIO
CONFIG_GPIO=y

# enable PWM
CONFIG_PWM=y

# enable SPI
CONFIG_SPI=y

# Enable uart driver
CONFIG_SERIAL=y

# enable console
CONFIG_CONSOLE=y
CONFIG_UART_CONSOLE=y

CONFIG_PINCTRL=y
```

## lib/sipf/Kconfig
```kconfig
#
# Copyright (c) 2021 SAKURA internet Inc.
#
# SPDX-License-Identifier: MIT
#

menuconfig SIPF 
	bool "SIPF client library"
	default n

#SIPF AUTH Protocol
config SIPF_AUTH_HOST
	string "SIPF AUTH host name."
	default "auth.sipf.iot.sakura.ad.jp"
config SIPF_AUTH_PATH
	string "SIPF AUTH endpoint."
	default "/v0/session_key"
config SIPF_AUTH_DISABLE_SSL
	bool "Disable SSL for SIPF AUTH endpoint."
	default n

#SIPF OBJECT Protocol
config SIPF_CONNECTOR_HTTP_HOST
	string "SIPF CONNECTOR HTTP host name."
	default "connector.sipf.iot.sakura.ad.jp"
config SIPF_CONNECTOR_PATH
	string "SIPF CONNECTOR HTTP endpoint."
	default "/v0"
config SIPF_CONNECTOR_DISABLE_SSL
	bool "Disable SSL for SIPF CONNECTOR HTTP endpoint."
	default n

#SIPF FILE Protocol
config SIPF_FILE_REQ_URL_HOST
	string "Host name of SIPF FILE: Request URL."
	default "file.sipf.iot.sakura.ad.jp"
config SIPF_FILE_REQ_URL_PATH
	string "Endpoint of SIPF FILE: Request URL."
	default "/v1/files/%s/"

module = SIPF
module-str = SIPF
source "subsys/logging/Kconfig.template.log_config"
```

## subsys/net/Kconfig
```kconfig
# Copyright (c) 2018 Nordic Semiconductor
#
# SPDX-License-Identifier: LicenseRef-Nordic-5-Clause
#

menu "Application protocols"

rsource "download_client/Kconfig"
rsource "fota_download/Kconfig"

endmenu
```
